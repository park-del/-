//              ----------------------------------------------------------------
//              GND   电源地
//              VCC   接5V或3.3v电源
//              SCL   P0.7 时钟引脚
//              SDA   P0.8 数据引脚
//              RES   接P0.9 复位引脚
//              DC    接P0.10 数据和命令控制引脚
//              CS    接地                 
//              ----------------------------------------------------------------
//******************************************************************************/
#include "LPC17xx.h"      
#include "stdio.h"
#include <time.h>
#define random(x) (rand()%x)   //宏定义随机函数

#define high 1
#define low 0 
#define OLED_CMD  0	//写命令
#define OLED_DATA 1	//写数据
#define FPCLK 25000000 
#define  UART_BPS  9600
 
int mm;
int LED[]={ 0,1<<18,1<<19,1<<20,1<<21,1<<22,1<<23,1<<24,1<<25 };
char frame[1024];/*OLED显示屏数据记录数组*/
int b1,b2,b3;  //保存每一位
int i,k,j; //hh代表游戏的基数,t用来表示游戏的难度,start用来表示开始游戏的标志
int q1[9]={7,4,3,8,1,0,5,2,9}; 
int q2[9]={7,1,8,3,9,5,6,2,4};
int q3[9]={7,9,2,3,6,5,1,4,8};
int ttt;
//0小鹿：1河马：2绵羊:3兔子：4犀牛：5小狗：6小猫：7小象：8袋鼠：9老鼠
void myDelay (uint32_t ulTime)
{
    uint32_t i;
   uint32_t j;
    i = 0;
	  j=0;
    while (ulTime--) {
        for (i = 0; i < 250; i++){for(j=0;j<4;j++);};
    }
} 
void GPIOInit( void )
{
	  int i;
    LPC_PINCON->PINSEL0  &= ~(0x3 << 20);       /* P0.7、P0.8、P0.9、P0.10为GPIO */
		LPC_PINCON->PINSEL0  &= ~(0x3 << 14);
		LPC_PINCON->PINSEL0  &= ~(0x3 << 16);
		LPC_PINCON->PINSEL0  &= ~(0x3 << 18);
	
	  LPC_GPIO0->FIODIR    |=  (1<<10);           /*  P0.7、P0.8、P0.9、P0.10为输出  */                
    LPC_GPIO0->FIODIR    |=  (1<<7);
	  LPC_GPIO0->FIODIR    |=  (1<<8);
	  LPC_GPIO0->FIODIR    |=  (1<<9);
 
	  LPC_GPIO2->FIODIR    |= (255<<0);      //设置P2.0---P2.7为GPIO输出    （其中R1---R4分别接P2.0---P2.3；其中L1---L4分别接P2.4---P2.7）
	
	  LPC_PINCON->PINSEL0 |= (0x01<<4)|(0x01<<6);  //设置P2.2和P2.3分别为TXD0和REDX0
	 
	
	  
	  LPC_PINCON->PINSEL3  &= ~(0x3<<4);    //P1.18
	  LPC_PINCON->PINSEL3  &= ~(0x3<<6);    //P1.19
	  LPC_PINCON->PINSEL3  &= ~(0x3<<8);    //P1.20
	  LPC_PINCON->PINSEL3  &= ~(0x3<<10);  //P1.21
		LPC_PINCON->PINSEL3  &= ~(0x3<<12);  //P1.22
		LPC_PINCON->PINSEL3  &= ~(0x3<<14);  //P1.23
		LPC_PINCON->PINSEL3  &= ~(0x3<<16);  //P1.24
		LPC_PINCON->PINSEL3  &= ~(0x3<<18);  //P1.25
		
		LPC_GPIO1->FIODIR    |= (255<<18); 
		
	 
	
	  LPC_GPIO0->FIOCLR |= (1<<9);   // RES=0;
	  myDelay(10);
	  LPC_GPIO0->FIOSET |= (1<<9);   // RES=1;
	  myDelay(10);
	 	LPC_GPIO0->FIOCLR |= (1<<10);   //DC=0;		
	  myDelay(10);
}

/****************************************************/
void Initial_LY096BG30();
void Delay_50ms(unsigned int Del_50ms);
void Delay_1ms(unsigned int Del_1ms);
void fill_picture(unsigned char fill_Data);
void Picture_1();
void Write_SPI_Command(unsigned char ucCmd);
void Write_SPI_Data(unsigned char ucData);
/***********************Initial code*********************/
void Initial_LY096BG30()
{
	Write_SPI_Command(0xAE);   //display off
	Write_SPI_Command(0x20);	//Set Memory Addressing Mode	
	Write_SPI_Command(0x10);	//00,Horizontal Addressing Mode;01,Vertical Addressing Mode;10,Page Addressing Mode (RESET);11,Invalid
	Write_SPI_Command(0xb0);	//Set Page Start Address for Page Addressing Mode,0-7
	Write_SPI_Command(0xc8);	//Set COM Output Scan Direction
	Write_SPI_Command(0x00);//---set low column address
	Write_SPI_Command(0x10);//---set high column address
	Write_SPI_Command(0x40);//--set start line address
	Write_SPI_Command(0x81);//--set contrast control register
	Write_SPI_Command(0x7f);
	Write_SPI_Command(0xa1);//--set segment re-map 0 to 127
	Write_SPI_Command(0xa6);//--set normal display
	Write_SPI_Command(0xa8);//--set multiplex ratio(1 to 64)
	Write_SPI_Command(0x3F);//
	Write_SPI_Command(0xa4);//0xa4,Output follows RAM content;0xa5,Output ignores RAM content
	Write_SPI_Command(0xd3);//-set display offset
	Write_SPI_Command(0x00);//-not offset
	Write_SPI_Command(0xd5);//--set display clock divide ratio/oscillator frequency
	Write_SPI_Command(0xf0);//--set divide ratio
	Write_SPI_Command(0xd9);//--set pre-charge period
	Write_SPI_Command(0x22); //
	Write_SPI_Command(0xda);//--set com pins hardware configuration
	Write_SPI_Command(0x12);
	Write_SPI_Command(0xdb);//--set vcomh
	Write_SPI_Command(0x20);//0x20,0.77xVcc
	Write_SPI_Command(0x8d);//--set DC-DC enable
	Write_SPI_Command(0x14);//
	Write_SPI_Command(0xaf);//--turn on oled panel 
}
/***********************Picture Code**************************/
void Write_SPI_Data(unsigned char ucData)    //SPI数据发送函数
{
    unsigned char i = 8;
	  LPC_GPIO0->FIOSET |= (1<<10);   //   DC   = 1;  数据
		LPC_GPIO0->FIOCLR |= (1<<7);   //    SCL  = 0;  时钟引脚
   
    while (i--)
    {
        if (ucData & 0x80)
        {
            LPC_GPIO0->FIOSET |= (1<<8);  // SDA = 1;   //把内容发过去
        } 
        else
        {
            LPC_GPIO0->FIOCLR	|= (1<<8);  // SDA = 0;
        }
         
        LPC_GPIO0->FIOSET |= (1<<7);   //    SCL = 1;  //给一个下降沿
       // _nop_();
        LPC_GPIO0->FIOCLR |= (1<<7);   //    SCL  = 0; 
        ucData <<= 1;    
    }

    return;
}

/*****************************************************************************/
void Write_SPI_Command(unsigned char ucCmd)  //SPI命令发送函数
{
    unsigned char i = 8;
    LPC_GPIO0->FIOCLR |= (1<<10);   //   DC  = 0;  命令
    LPC_GPIO0->FIOCLR |= (1<<7);   //    SCL = 0;  时钟引脚
    while (i--)
    {
        if (ucCmd & 0x80)
        {
             LPC_GPIO0->FIOSET |= (1<<8);  // SDA = 1; //把内容发过去
        }
        else
        {
            LPC_GPIO0->FIOCLR	|= (1<<8);  // SDA = 0;
        }
          
        LPC_GPIO0->FIOSET |= (1<<7);   //    SCL = 1;   //给一个下降沿
        //_nop_();
        LPC_GPIO0->FIOCLR |= (1<<7);   //    SCL  = 0;  
        ucCmd <<= 1;   
    }  

    return;
}

void fill_picture(unsigned char fill_Data)   //填充数据
{
	unsigned char m,n;
	for(m=0;m<8;m++)
	{
		Write_SPI_Command(0xb0+m);	 //设置页地址后三位控制0~7页，其低三位的值对应着GRAM的页地址。
		Write_SPI_Command(0x00);	 //用于设置显示时的起始列地址低四位。
		Write_SPI_Command(0x10);     //用于设置显示时的起始列地址高四位。
		for(n=0;n<128;n++)
			{
				Write_SPI_Data(fill_Data);
			}
	}
}
void UART0_int()
{
   int Fdiv;
   LPC_UART0->FCR =0x07;
	
   LPC_UART0->LCR =0x83;     
   Fdiv = (FPCLK /4 / 16) / UART_BPS;
   LPC_UART0->DLM = Fdiv / 256;
   LPC_UART0->DLL = Fdiv % 256;
   LPC_UART0->LCR =0x03;
}
 
int UART0_recedata()
{
	 if((LPC_UART0->LSR &0x01) == 1 )    //等待接收数据完毕
        mm= LPC_UART0->RBR;     
}
   
 
unsigned char a[10][200]=    //各个图案代表的数字
{
//小鹿：
0x00,0x00,0x00,0x00,0x00,0x00,0x00,0x00,0x00,0x00,0x80,0x80,0xF8,0x78,0x78,0x78,
0x78,0xF8,0xE0,0xE0,0xE0,0xE0,0x78,0x78,0x78,0xE0,0xE0,0x00,0x00,0x00,0x00,0x00,
0x00,0x00,0x00,0x00,0x00,0x00,0x00,0x00,0x00,0x00,0xE0,0xF0,0xF0,0x10,0x10,0x10,
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0x00,0x00,0x00,0x00,0x00,0x00,0x00,0x00,


//河马：
0x00,0x00,0x00,0x00,0x00,0x00,0x00,0x00,0x00,0x80,0xE0,0x30,0x30,0x30,0xE0,0xC0,
0x00,0x00,0x00,0x00,0x00,0x00,0x00,0xC0,0xE0,0x30,0x18,0x18,0xF0,0xC0,0x00,0x00,
0x00,0x00,0x00,0x00,0x00,0x00,0x00,0x00,0x00,0x00,0x00,0x00,0x00,0x00,0x00,0x00,
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0x01,0x00,0x00,0x00,0x00,0x00,0x00,0x00,
	
//绵羊:
0x00,0x00,0x00,0x00,0x00,0x00,0x00,0x00,0x00,0x00,0x00,0x00,0x00,0x80,0x80,0x80,
0x80,0x00,0x80,0xC0,0xC0,0xC0,0xC0,0x80,0x80,0x00,0x80,0x80,0x80,0x00,0x00,0x00,
0x00,0x00,0x00,0x00,0x00,0x00,0x00,0x00,0x00,0x00,0x00,0x00,0x00,0x00,0x00,0x00,
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0x00,0x00,0x00,0x00,0x00,0x00,0x00,0x00,


	

//兔子：
0x00,0x00,0x00,0x00,0x00,0x00,0xF8,0xFE,0x03,0x03,0x02,0x0C,0x38,0xE0,0x00,0x00,
0x00,0x00,0x00,0x00,0x00,0x00,0x00,0x80,0xE0,0x38,0x0C,0x04,0x06,0x06,0xFC,0x00,
0x00,0x00,0x00,0x00,0x00,0x00,0x00,0x00,0x00,0x00,0x00,0x00,0x00,0x00,0x00,0x07,
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0x00,0x00,0x00,0x00,0x00,0x00,0x00,0x00,


//犀牛：
0x00,0x00,0x00,0x00,0x00,0x00,0x00,0x00,0x00,0x00,0x00,0x00,0x00,0x00,0x00,0x00,
0x00,0x00,0x00,0x00,0x00,0x00,0x00,0x00,0x00,0x00,0x00,0x00,0x00,0x00,0x00,0x00,
0x00,0x00,0x00,0x00,0x00,0x00,0x00,0x00,0x00,0x00,0x00,0xC0,0xE0,0x30,0x30,0x30,
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0x00,0x00,0x00,0x00,0x00,0x00,0x00,0x00,




//小狗：

0x00,0x00,0x00,0x00,0x00,0x00,0x00,0x00,0x00,0xF0,0xF8,0xF8,0xD0,0xE0,0xC0,0x80,
0x00,0x00,0x00,0x00,0x00,0x00,0x00,0x00,0xA0,0xD0,0x60,0xF0,0x78,0xE8,0x18,0xF0,
0x00,0x00,0x00,0x00,0x00,0x00,0x00,0x00,0x00,0x00,0x00,0x00,0x00,0x00,0x00,0x00,
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0x00,0x00,0x00,0x00,0x00,0x00,0x00,0x00,



//小猫：
0x00,0x00,0x00,0x00,0x00,0x00,0x00,0x80,0x80,0x80,0x80,0x00,0x80,0x80,0xC0,0x40,
0x60,0xE0,0x60,0x60,0x60,0x60,0x60,0xC0,0xC0,0xC0,0x80,0x80,0xC0,0xC0,0xC0,0x80,
0x80,0x00,0x00,0x00,0x00,0x00,0x00,0x00,0x00,0x00,0x00,0x00,0x00,0xFF,0xE1,0xFD,
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0x01,0x00,0x00,0x00,0x00,0x00,0x00,0x00,



//小象：
0x00,0x00,0x00,0x00,0x00,0x00,0x00,0x00,0x00,0x00,0x00,0x00,0x00,0x00,0x00,0x00,
0x00,0x00,0x00,0x00,0x00,0x00,0x00,0x00,0x00,0x00,0x00,0x80,0xC0,0x40,0x40,0xC0,
0x80,0x00,0x00,0x00,0x00,0x00,0x00,0x00,0x00,0x00,0x00,0x00,0x00,0x80,0x80,0xC0,
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0x00,0x00,0x00,0x00,0x00,0x00,0x00,0x00,



//袋鼠：

0x00,0x00,0x00,0x00,0x00,0x00,0x00,0x00,0x00,0x00,0x00,0x00,0x00,0x00,0x00,0x00,
0x00,0x00,0x00,0x00,0x00,0x00,0x00,0x80,0xC0,0xE0,0x70,0x34,0x18,0xF8,0xF0,0x00,
0x00,0x80,0x80,0xC0,0xC0,0xC0,0x80,0x00,0x00,0x00,0x00,0x00,0x00,0x00,0x00,0x00,
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0x60,0x78,0x1F,0x07,0x00,0x00,0x00,0x00,



//老鼠：
0x00,0x00,0x00,0x00,0x00,0x80,0x80,0xC0,0xC0,0xE0,0x60,0xF0,0x40,0xE0,0x80,0x00,
0x00,0x00,0x00,0x00,0x00,0x00,0x00,0x00,0xC0,0xC0,0xE0,0x70,0x70,0xA0,0x60,0xE0,
0xC0,0xC0,0x00,0x00,0x00,0x00,0x00,0x00,0x00,0x00,0x00,0x00,0x7E,0xFF,0xA9,0xC8,
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0x03,0x00,0x00,0x00,0x00,0x00,0x00,0x00
};

unsigned char base[ ]=      //base:8*32
{
0xFF,0x88,0x88,0x70,0x00,0x50,0xA8,0xA8,0xF0,0x80,0x00,0xB8,0xA8,0xA8,0xE8,0x00,
0x00,0x70,0xA8,0xA8,0xB8,0x00,0xD8,0xD8
};

unsigned char total1[ ]=    //total:8*16
{
0x04,0x7F,0x44,0x44,0x00,0x38,0x44,0x44,0x38,0x00,0x00,0x04,0x7F,0x44,0x44,0x00,
0x28,0x54,0x54,0x78,0x40,0x00,0x41,0x7F,0x40,0x00,0x6C,0x6C,0x00,0x00,0x00,0x00
};
unsigned char shuzi[ ][5]=  //total与base的各个数字
{
0xFF,0x81,0x81,0x81,0xFF,     //0
0x80,0x82,0xFF,0x80,0x80,     //1
0xF9,0x89,0x89,0x89,0x8F,     //2
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0x8F,0x89,0x89,0x89,0xFF//9
};

unsigned char kuang[ ]=     //框架56*128（不包括显示图案，不包括菜单total和base）
{

 0xFB,0xE7,0x9F,0xC7,0x9F,0xE7,0xFB,0xFF,0xC7,0xAB,0xAB,0xAB,0xA7,0xFF,0x80,0xFF,
 0xC7,0xBB,0xBB,0xBB,0xFF,0xC7,0xBB,0xBB,0xBB,0xC7,0xFF,0x83,0xFB,0x83,0xFB,0x83,
 0xFF,0xC7,0xAB,0xAB,0xAB,0xA7,0xFF,0xFF,0xFF,0xFB,0x81,0xBB,0xBB,0xFF,0xC7,0xBB,
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 0xF3,0xC3,0x87,0xC3,0xF3,0xFF,0xFF,0xFF,0xF3,0xC3,0x87,0xC3,0xF3,0xFF,0xFF,0xFF
};


 unsigned char SINGLE[]=   //笑脸，SINGLE事件
{
0x00,0x00,0x00,0x00,0x00,0x00,0x00,0x00,0x00,0x80,0xC0,0x40,0x60,0x30,0x18,0x18,
0x0C,0x0C,0x04,0x06,0x06,0x06,0x06,0x06,0x06,0x06,0x06,0x06,0x06,0x06,0x06,0x06,
0x04,0x0C,0x08,0x18,0x10,0x30,0x60,0xC0,0xC0,0x80,0x00,0x00,0x00,0x00,0x00,0x00,
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0x00,0x00,0x00,0x00,0x00,0x00,0x00,0x00,0x00,0x00,0x00,0x00,0x00,0x00,
};
unsigned char NORMAL[]=   //爱心脸，NORMAL事件
{
0x00,0x00,0x00,0x00,0x00,0x00,0x00,0x80,0xC0,0xE0,0xF0,0xF0,0x78,0x78,0x3C,0x3C,
0x1E,0x1E,0x0E,0x0E,0x0F,0x0F,0x0F,0x07,0x07,0x07,0x0F,0x0F,0x0F,0x0F,0x0E,0x1E,
0x1E,0x1C,0x3C,0x3C,0x78,0xF8,0xF0,0xE0,0xC0,0x80,0x00,0x00,0x00,0x00,0x00,0x00,
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0x00,0x00,0x00,0x00,0x00,0x00,0x00,0x00,0x00,0x00,0x00,0x00,0x00,0x00
};


unsigned char  BIG[]=    //松树，BIG事件
{
0x00,0x00,0x00,0x00,0x00,0x00,0x00,0x00,0x00,0x00,0x00,0x00,0x00,0x00,0x40,0xC0,
0xC0,0x40,0x60,0x30,0x1E,0x06,0x0C,0x18,0x10,0x10,0x90,0x50,0x30,0x10,0x00,0x00,
0x00,0x00,0x00,0x00,0x00,0x00,0x00,0x00,0x00,0x00,0xFC,0x24,0x24,0x24,0xF8,0x00,
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0x00,0x00,0x00,0x00,0x00,0x00,0x02,0x02,0x00,0x00,0x00,0x00,0x02,0x02

};
unsigned char LOSE[]=   //瘪嘴脸，LOSE事件
{
0x00,0x00,0x00,0x00,0x00,0x00,0x00,0x00,0x00,0x80,0xC0,0xE0,0xE0,0xF0,0xF8,0xF8,
0xF8,0x7C,0x7C,0x7C,0x3E,0x3E,0x3E,0x3E,0x3E,0x3E,0x3E,0x3E,0x3E,0x3E,0x7C,0x7C,
0x7C,0xF8,0xF8,0xF8,0xF0,0xE0,0xE0,0xC0,0x80,0x00,0x00,0x00,0x00,0x00,0x00,0x00,
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0x00,0x00,0x00,0x00,0x00,0x00,0x00,0x00,0x00,0x00,0x00,0x00,0x00,0x00
};
/********************************************************************/
void OLED_Drawbmp(uint8_t x,uint8_t y,char *bmp,uint8_t m,uint8_t n)//OLED画图像函数,图像一共有128*64（128为图像的长，64位图像的宽，总共有128*64个点），x、y是定位到某一个位置，总共由128列，64行
//x是定位到某一列的，y是定位到某一行的，bmp这个数组存放的是某个图像的模，后面的m与n分别表示了bmp这个图像的长和宽。（即是bmp和m和n共同表示了一个图像，x和y是表示这个图像显示的位置）
{   
	//x为列，y为行，*bmp为数组，n为高度，m为宽度
        uint8_t i,j,page1=y/8,page2=n/8+page1,a=0x0F&x,b=(0xF0&x)>>4|0x10; //page是这个图像起始的页数，page2是这个图像末尾的页数，page2-page1是这个图像一共占了多少页
//a表示        
	
	      for(i=0;page1<page2;i++,page1++)
        {
                Write_SPI_Command(0xb0+page1);
                Write_SPI_Command(a);
                Write_SPI_Command(b);
                for(j=0;j<m;j++)
                {
                        frame[page1*128+x+j]|=(bmp[i*m+j]<<y%8);;
                        frame[page1*128+x+j]&=(0xFF>>(8-y%8)|(bmp[i*m+j]<<y%8));
                        Write_SPI_Data(frame[page1*128+x+j]);
                }
          if(page1<7&&y%8)
                {
                       Write_SPI_Command(0xb0+page1+1);
                       Write_SPI_Command(a);
                       Write_SPI_Command(b);
                  for(j=0;j<m;j++)
                  {
                          frame[(page1+1)*128+x+j]|=(bmp[i*m+j]>>(8-y%8));
                                frame[(page1+1)*128+x+j]&=((0xFF<<y%8)|(bmp[i*m+j]>>(8-y%8)));
                          Write_SPI_Data(frame[(page1+1)*128+x+j]);
                  }
                }
        }
}

int ROW[]={ 1<<0,1<<0,1<<1,1<<2,1<<3};  //有四行，分别用ROW[1]------ROW[4]来表示
int COL[]={ 1<<0,1<<4,1<<5,1<<6,1<<7};  //有四列，分别用COL[1]------COL[4]来表示             
uint8_t key=0;	
uint8_t  KEY_Scan(void)
{	
	      LPC_GPIO2->FIODIR  |= (1<<0 | 1<<1 | 1<<2 | 1<<3 );        //让四条行线都为输出模式
	      LPC_GPIO2->FIOSET = ROW[1] | ROW[2]| ROW[3] | ROW[4];    //让四条行线都输出高电平 
				//-------------- 扫描第1列 --------------
				LPC_GPIO2->FIOCLR   = COL[1];  //第1列输出低电平，第2、3、4列输出高电平
				LPC_GPIO2->FIOSET  = COL[2] | COL[3] | COL[4];
				 
				
				LPC_GPIO2->FIODIR  &=~(1<<0 | 1<<1 | 1<<2 | 1<<3 );    //让四条行线都为输入模式
				if((LPC_GPIO2->FIOPIN & (1<<0) ) == 0)  key='1';    //第1列、第1行的按键按下 
				if((LPC_GPIO2->FIOPIN & (1<<1) ) == 0)  key='2';    //第1列、第2行的按键按下
				if((LPC_GPIO2->FIOPIN & (1<<2) ) == 0)  key='3';    //第1列、第3行的按键按下
				if((LPC_GPIO2->FIOPIN & (1<<3) ) == 0)  key='A';    //第1列、第4行的按键按下

				myDelay(10);
				//-------------- 扫描第2列 --------------
		 
				LPC_GPIO2->FIODIR  |= (1<<0 | 1<<1 | 1<<2 | 1<<3 ); 
				LPC_GPIO2->FIOSET = ROW[1] | ROW[2]| ROW[3] | ROW[4];    //让四条行线都输出高电平 
				LPC_GPIO2->FIOCLR  |= COL[2];  //第2列输出低电平，第1、3、4列输出高电平
			    LPC_GPIO2->FIOSET  |= COL[1] | COL[3] | COL[4];
					
					
				LPC_GPIO2->FIODIR  &=~(1<<0 | 1<<1 | 1<<2 | 1<<3 );
				if((LPC_GPIO2->FIOPIN & (1<<0) ) == 0)  key='4';    //第2列、第1行的按键按下
				if((LPC_GPIO2->FIOPIN & (1<<1) ) == 0)  key='5';    //第2列、第2行的按键按下
				if((LPC_GPIO2->FIOPIN & (1<<2) ) == 0)  key='6';    //第2列、第3行的按键按下
				if((LPC_GPIO2->FIOPIN & (1<<3) ) == 0)  key='B';    //第2列、第4行的按键按下

				myDelay(10);
				//-------------- 扫描第3列 --------------
				 
				LPC_GPIO2->FIODIR  |= (1<<0 | 1<<1 | 1<<2 | 1<<3 ); 
				LPC_GPIO2->FIOSET = ROW[1] | ROW[2]| ROW[3] | ROW[4];    //让四条行线都输出高电平 
				LPC_GPIO2->FIOCLR   = COL[3];  //第3列输出低电平，第1、2、4列输出高电平
			    LPC_GPIO2->FIOSET  = COL[1] | COL[2] | COL[4];
				 
					
					
				LPC_GPIO2->FIODIR  &=~(1<<0 | 1<<1 | 1<<2 | 1<<3 );
				if((LPC_GPIO2->FIOPIN & (1<<0) ) == 0)  key='7';    //第1列、第1行的按键按下
				if((LPC_GPIO2->FIOPIN & (1<<1) ) == 0)  key='8';    //第1列、第2行的按键按下
				if((LPC_GPIO2->FIOPIN & (1<<2) ) == 0)  key='9';    //第1列、第3行的按键按下
				if((LPC_GPIO2->FIOPIN & (1<<3) ) == 0)  key='C';  //第1列、第4行的按键按下
				
				myDelay(10);
				//-------------- 扫描第4列 --------------
				 
				LPC_GPIO2->FIODIR  |= (1<<0 | 1<<1 | 1<<2 | 1<<3 ); 
				LPC_GPIO2->FIOSET = ROW[1] | ROW[2]| ROW[3] | ROW[4];    //让四条行线都输出高电平 
				LPC_GPIO2->FIOCLR  = COL[4];  //第3列输出低电平，第1、2、3列输出高电平
			  LPC_GPIO2->FIOSET  = COL[1] | COL[2] | COL[3];
				 
				 
				LPC_GPIO2->FIODIR  &=~(1<<0 | 1<<1 | 1<<2 | 1<<3 ); 
				if((LPC_GPIO2->FIOPIN & (1<<0) ) == 0)  key='*';    //第1列、第1行的按键按下
				if((LPC_GPIO2->FIOPIN & (1<<1) ) == 0)  key='0';    //第1列、第2行的按键按下
				if((LPC_GPIO2->FIOPIN & (1<<2) ) == 0)  key='#';    //第1列、第3行的按键按下
				if((LPC_GPIO2->FIOPIN & (1<<3) ) == 0)  key='D';    //第1列、第4行的按键按下
				
				 
				LPC_GPIO2->FIOCLR  = COL[1] | COL[2] | COL[3] | COL[4];    //让四条列线都输出低电平 
				myDelay(100);
				
			 
}

void model_1()  //LOSE事件
{
	int i;
	for(i=1;i<=8;i++)
  {  
		LPC_GPIO1->FIOCLR |=LED[i];
	  myDelay(400);
	}
	
  LPC_GPIO1->FIOSET |=LED[1]| LED[2]| LED[3]| LED[4] | LED[5]| LED[6]| LED[7]| LED[8];
	
	myDelay(2000);
	for(i=8;i>=1;i--)
  {  
		LPC_GPIO1->FIOCLR |=LED[i];
	  myDelay(400);
	}
	
 LPC_GPIO1->FIOSET |=LED[1]| LED[2]| LED[3]| LED[4] | LED[5]| LED[6]| LED[7]| LED[8];
}

void model_2() //NORMAL事件
{
  int i,t=0;
	while(1)
	{
		if(t>=3) break;
		for(i=1,j=2;j<=8;j++,i++)
		{
   			 LPC_GPIO1->FIOCLR |=LED[i]| LED[j]; 
	       myDelay(1000);
	       LPC_GPIO1->FIOSET |=LED[1]| LED[2]| LED[3]| LED[4] | LED[5]| LED[6]| LED[7]| LED[8];
         myDelay(1000);
	  }
		t++;
	}
}
void model_3() //SINGLE事件
{
	int i,j;
  
	LPC_GPIO1->FIOCLR |=LED[1]| LED[2]| LED[7]| LED[8];
	myDelay(1000);
	LPC_GPIO1->FIOSET |=LED[1]| LED[2]| LED[7]| LED[8];
	
	
	LPC_GPIO1->FIOCLR |=LED[5]| LED[6]| LED[1]| LED[2];
	myDelay(1000);
	LPC_GPIO1->FIOSET |=LED[5]| LED[6]| LED[1]| LED[2];
	
	LPC_GPIO1->FIOCLR |=LED[3]| LED[4]| LED[7]| LED[8];
	myDelay(1000);
	LPC_GPIO1->FIOCLR |=LED[3]| LED[4]| LED[7]| LED[8];
	
	for(i=1,j=8;i<=4;i++,j--)
  {  
		LPC_GPIO1->FIOCLR |=LED[i]| LED[j];
	  myDelay(400);
	}
	
	LPC_GPIO1->FIOSET |=LED[1]| LED[2]| LED[3]| LED[4] | LED[5]| LED[6]| LED[7]| LED[8];
	
	for(i=4,j=5;i>=1;i--,j++)
  {  
		LPC_GPIO1->FIOCLR |=LED[i]| LED[j];
	  myDelay(400);
	}
	LPC_GPIO1->FIOSET |=LED[1]| LED[2]| LED[3]| LED[4] | LED[5]| LED[6]| LED[7]| LED[8];
	
}

void model_4() //BIG事件
{
	int t=20;
	while(1)
	{
	if(t<=0) break;
  for(i=1,j=8;i<=4;i++,j--)
  {  
		LPC_GPIO1->FIOCLR |=LED[i]| LED[j];
	  myDelay(10*t);
	}
	
	myDelay(100);
	LPC_GPIO1->FIOSET |=LED[1]| LED[2]| LED[3]| LED[4] | LED[5]| LED[6]| LED[7]| LED[8];
  myDelay(100);
	
	for(i=1,j=8;i<=4;i++,j--)
  {  
		LPC_GPIO1->FIOCLR |=LED[i]| LED[j];
	  myDelay(10*t);
	}
	
	myDelay(1000);
	LPC_GPIO1->FIOSET |=LED[1]| LED[2]| LED[3]| LED[4] | LED[5]| LED[6]| LED[7]| LED[8];
  myDelay(1000);
	
	t--;
  }
	
	LPC_GPIO1->FIOSET |=LED[1]| LED[2]| LED[3]| LED[4] | LED[5]| LED[6]| LED[7]| LED[8];
}




int reward=0,hh=1,total=0,k=1,tt=1; //reward代表奖励，hh代表游戏设置的基数，total代表游戏玩家当前的硬币数
int m; char *t;
void delay()
{
	if(tt==1)
      myDelay(400);
	if(tt==2)
		  myDelay(1200);
	if(tt==3)
		  myDelay(2000);
}

void show_total()
{
  int b4,b3,b2,b1;
  b1=total%10;
	b2=(total%100-total%10)/10;
	b3=(total%1000-total%100-total%10)/100;
	b4=(total%10000-total%1000-total%100-total%10)/1000;
  
	switch(b4)
	{
		case 0: OLED_Drawbmp(33,0, shuzi[0],5,8);  break;
		case 1: OLED_Drawbmp(33,0, shuzi[1],5,8);  break;
		case 2: OLED_Drawbmp(33,0, shuzi[2],5,8);  break;
		case 3: OLED_Drawbmp(33,0, shuzi[3],5,8); break;
		case 4: OLED_Drawbmp(33,0, shuzi[4],5,8); break;
		case 5: OLED_Drawbmp(33,0, shuzi[5],5,8);  break;
		case 6: OLED_Drawbmp(33,0, shuzi[6],5,8);  break;
		case 7: OLED_Drawbmp(33,0, shuzi[7],5,8);  break;
		case 8: OLED_Drawbmp(33,0, shuzi[8],5,8);  break;
		case 9: OLED_Drawbmp(33,0, shuzi[9],5,8);  break;
	}
	
	switch(b3)
	{
	  case 0: OLED_Drawbmp(39,0, shuzi[0],5,8);  break;
		case 1: OLED_Drawbmp(39,0, shuzi[1],5,8);  break;
		case 2: OLED_Drawbmp(39,0, shuzi[2],5,8);  break;
		case 3: OLED_Drawbmp(39,0, shuzi[3],5,8); break;
		case 4: OLED_Drawbmp(39,0, shuzi[4],5,8); break;
		case 5: OLED_Drawbmp(39,0, shuzi[5],5,8);  break;
		case 6: OLED_Drawbmp(39,0, shuzi[6],5,8);  break;
		case 7: OLED_Drawbmp(39,0, shuzi[7],5,8);  break;
		case 8: OLED_Drawbmp(39,0, shuzi[8],5,8);  break;
		case 9: OLED_Drawbmp(39,0, shuzi[9],5,8);  break;
	}

  switch(b2)
	{
	  case 0: OLED_Drawbmp(45,0, shuzi[0],5,8);  break;
		case 1: OLED_Drawbmp(45,0, shuzi[1],5,8);  break;
		case 2: OLED_Drawbmp(45,0, shuzi[2],5,8);  break;
		case 3: OLED_Drawbmp(45,0, shuzi[3],5,8); break;
		case 4: OLED_Drawbmp(45,0, shuzi[4],5,8); break;
		case 5: OLED_Drawbmp(45,0, shuzi[5],5,8);  break;
		case 6: OLED_Drawbmp(45,0, shuzi[6],5,8);  break;
		case 7: OLED_Drawbmp(45,0, shuzi[7],5,8);  break;
		case 8: OLED_Drawbmp(45,0, shuzi[8],5,8);  break;
		case 9: OLED_Drawbmp(45,0, shuzi[9],5,8);  break;
	}
  
  switch(b1)
	{
	  case 0: OLED_Drawbmp(51,0, shuzi[0],5,8);  break;
		case 1: OLED_Drawbmp(51,0, shuzi[1],5,8);  break;
		case 2: OLED_Drawbmp(51,0, shuzi[2],5,8);  break;
		case 3: OLED_Drawbmp(51,0, shuzi[3],5,8); break;
		case 4: OLED_Drawbmp(51,0, shuzi[4],5,8); break;
		case 5: OLED_Drawbmp(51,0, shuzi[5],5,8);  break;
		case 6: OLED_Drawbmp(51,0, shuzi[6],5,8);  break;
		case 7: OLED_Drawbmp(51,0, shuzi[7],5,8);  break;
		case 8: OLED_Drawbmp(51,0, shuzi[8],5,8);  break;
		case 9: OLED_Drawbmp(51,0, shuzi[9],5,8);  break;
	}		
}



void init()         //游戏初始界面
{  
	int i;
  while(1)
	{
		if(m==4)
		{	 
			fill_picture(0x00);
			m=0;
		}
		 
		if(hh==1)  {   reward=0;  OLED_Drawbmp(93,0, shuzi[1],5,8);    t=shuzi[1];   } //游戏初始的基数
		if(hh==2)  {   reward=0;  OLED_Drawbmp(93,0, shuzi[2],5,8);    t=shuzi[2];   }  //在这里设置游戏的基数
	  if(hh==3)  {   reward=0;  OLED_Drawbmp(93,0, shuzi[3],5,8);    t=shuzi[3];   }
    if(key=='5' || mm=='5')  { myDelay(2000); total++; key=0; mm=0;}  
		if(key=='8' || mm=='8')  { myDelay(2000); total--; key=0; mm=0;}  
		
		show_total();                    //显示筹码的数目
		OLED_Drawbmp(0,0, total1,32,8);  //游戏初始的显示total和base的界面
		OLED_Drawbmp(65,0, base,24,8);
		OLED_Drawbmp(0,9, kuang,128,56); 
		
		
		OLED_Drawbmp(2,17, a[7],40,40);  //参数为列，行，数组，高度，宽度
		OLED_Drawbmp(44,17,a[7],40,40);
		OLED_Drawbmp(86,17,a[7],40,40);
		
		
	 
	  KEY_Scan();   UART0_recedata();  
		{
			if(key=='4' || mm=='4')
			{ 
        myDelay(2000);
				total--; key=0; mm=0;
				show_total();
				break;  //开始游戏
		  }
		     
		  if(key=='6'|| mm=='6')  //hh只有三个取值，即游戏只有3个基数
		  {    
				 myDelay(2000);
			   hh++;
		     if(hh>=4) hh=1;	
			   key=0;  mm=0;
		  }
		
		if(key=='7' || mm=='7')   //设置游戏难度，tt只有三个值，即是游戏难度只有三个(作弊键)
		{	
			myDelay(2000);
			tt++;
			if(tt>=4) tt=1;
			key=0; mm=0;
		}
		
	  }
	}
}

 
void start_game()
{
  m=0;
  while(1)   //第1个while
	{     
	for(i=0;i<=9;i++) //行数只有两行，即是1和32;列数是有0、25、50、75四列的
  {
	 KEY_Scan();  UART0_recedata();
	 OLED_Drawbmp(3,17, a[q1[i]],40,40);  //参数为列，行，数组，高度，宽度
	 OLED_Drawbmp(45,17,a[q2[i]],40,40);
	 OLED_Drawbmp(87,17,a[q3[i]],40,40);
		 
	 KEY_Scan();  //UART0_recedata();
	 delay();
		
	 if(key=='1' || mm=='1')  { b1=i; break;}	 if( key=='9'||mm=='9' )  {  ttt=rand()%2; if( ttt==0 )b1=3;  if(ttt==1) b1=7;  break; }
   }   
	if(key=='1' || mm=='1') break;  if( key=='9'||mm=='9' )  {  break; }
	}  //while大循环
	
	 
	 while(1)   //第2个while
	{     
		 for(j=0;j<=9;j++)
		 { 
			 KEY_Scan();   UART0_recedata();
			 OLED_Drawbmp(3,17, a[b1],40,40);  //参数为列，行，数组，高度，宽度
		   OLED_Drawbmp(45,17,a[q2[j]],40,40);
		   OLED_Drawbmp(87,17,a[q3[j]],40,40);
			 
			 KEY_Scan();  //UART0_recedata();
		    delay();
			 if( key=='2' || mm=='2') { b2=j; break; } if( key=='9'||mm=='9' )  { if( ttt==0 )b2=3;  if(ttt==1) b2=7;  break; }
		 }   
			if(key=='2' || mm=='2') break;  if( key=='9'||mm=='9' )  {   break; }
	}  //while大循环
	
		
		while(1)   //第3个while
	{     
		 for(k=0;k<=9;k++)
		 { 
			 KEY_Scan();  UART0_recedata();
		   OLED_Drawbmp(3,17, a[b1],40,40);  //参数为列，行，数组，高度，宽度
		   OLED_Drawbmp(45,17,a[b2],40,40);
		   OLED_Drawbmp(87,17,a[q3[k]],40,40);
		   
			 KEY_Scan();  UART0_recedata();
			  delay();
	 		if(key=='3' || mm=='3') { b3=k; break;	}		if( key=='9'||mm=='9' )  { if( ttt==0 )b3=3;  if(ttt==1) b3=7; break; }
	   }  //while大循环
		 if(key=='3' || mm=='3') break;  if( key=='9'||mm=='9' )  {    break; }
	  }  //while大循环
	
	while(1)   //第4个while
	{     
		    
		   OLED_Drawbmp(3,17, a[b1],40,40);  //参数为列，行，数组，高度，宽度
		   OLED_Drawbmp(45,17,a[b2],40,40);
		   OLED_Drawbmp(87,17,a[b3],40,40);
		   
		 
       m++;
       if(m==4)   //游戏结束后经过一段时间后会自动退出
       {
				 myDelay(3*8000);
				 break;		
			 }				 
	  }  //while大循环
}
void result()
{
  if( (b1==b2&&b2!=b3 )||(b2==b3&&b2!=b1 ))		//SINGLE事件3枚
	{
	reward+=3*hh; fill_picture(0x00);
	OLED_Drawbmp(34,8, SINGLE,50,50);
	model_2();
	}
	else if( (b1==b2 && b2==b3 && b1==b3 )&& (b1!=3) && (b1!=7))		 //NORMAL事件20枚
	{
	reward+=20*hh; fill_picture(0x00);
	OLED_Drawbmp(34,8,NORMAL,50,50);
	model_3();
	}
	else if( (b1==b2 && b2==b3 && b1==b3 && b1==3)||(b1==b2 && b1==b3 && b2==b3 && b1==7 ) )		//BIG事件100枚
	{
	reward+=100*hh; fill_picture(0x00);
	OLED_Drawbmp(34,8,BIG,50,50);
	model_4();
	
	}
	else     	                  //LOSE事件-1枚
  {
	reward-=1*hh; fill_picture(0x00);
	OLED_Drawbmp(34,8,LOSE,50,50);
	model_1();
	}
	total+=reward;
	 
	show_total();                    //显示筹码的数目
  OLED_Drawbmp(0,0, total1,32,8);  //游戏初始的显示total和base的界面
	OLED_Drawbmp(65,0, base,24,8);
	OLED_Drawbmp(93,0, t,5,8);
	myDelay(12000*3);
}  



int main(void)
{
	SystemInit();                                                      
  GPIOInit(); 
  Initial_LY096BG30();
	fill_picture(0x00);
	UART0_int();
	
	for(i=1;i<=8;i++)      //使刚开始时的灯全灭
  	LPC_GPIO1->FIOSET |=LED[i];   
 
	//按键1：开始游戏（标志位为start）  按键6：修改基数(hh)  按键5：投币（）  按键7：设置游戏难度(tt) 
	while(1)
	{
	init(); //游戏刚开始时的界面 
  start_game();
  result();
	}
	return 0;
}
