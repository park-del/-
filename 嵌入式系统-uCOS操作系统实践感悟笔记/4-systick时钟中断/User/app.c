/*
************************************************************************************************************************
*                                                 包含的头文件
************************************************************************************************************************
*/
#include "os.h"
#include "ARMCM3.h"

/*
************************************************************************************************************************
*                                                   宏定义
************************************************************************************************************************
*/


/*
************************************************************************************************************************
*                                                  全局变量
************************************************************************************************************************
*/

uint32_t flag1;
uint32_t flag2;

/*
************************************************************************************************************************
*                                                  TCB & STACK & 任务声明
************************************************************************************************************************
*/
#define  TASK1_STK_SIZE       20
#define  TASK2_STK_SIZE       20

static   CPU_STK   Task1Stk[TASK1_STK_SIZE];
static   CPU_STK   Task2Stk[TASK2_STK_SIZE];

static   OS_TCB    Task1TCB;
static   OS_TCB    Task2TCB;

void     Task1( void *p_arg );
void     Task2( void *p_arg );

/*
************************************************************************************************************************
*                                                  函数声明
************************************************************************************************************************
*/
void delay(uint32_t count);

/*
************************************************************************************************************************
*                                                    main函数
************************************************************************************************************************
*/
/*
* 注意事项：1、该工程使用软件仿真，debug需选择 Ude Simulator
*           2、在Target选项卡里面把晶振Xtal(Mhz)的值改为25，默认是12，
*              改成25是为了跟system_ARMCM3.c中定义的__SYSTEM_CLOCK相同，确保仿真的时候时钟一致
*/
int main(void)
{	
	OS_ERR err;
	
	/* 关闭中断 */
	CPU_IntDis();
	
	/* 配置SysTick 10ms 中断一次 */
	OS_CPU_SysTickInit (10);
	
	/* 初始化相关的全局变量 */
	OSInit(&err);
	
	/* 创建任务 */
	OSTaskCreate ((OS_TCB*)      &Task1TCB, 
	              (OS_TASK_PTR ) Task1, 
	              (void *)       0,
	              (CPU_STK*)     &Task1Stk[0],
	              (CPU_STK_SIZE) TASK1_STK_SIZE,
	              (OS_ERR *)     &err);

	OSTaskCreate ((OS_TCB*)      &Task2TCB, 
	              (OS_TASK_PTR ) Task2, 
	              (void *)       0,
	              (CPU_STK*)     &Task2Stk[0],
	              (CPU_STK_SIZE) TASK2_STK_SIZE,
	              (OS_ERR *)     &err);
				  
	/* 将任务加入到就绪列表 */
	OSRdyList[0].HeadPtr = &Task1TCB;
	OSRdyList[1].HeadPtr = &Task2TCB;
	
	/* 启动OS，将不再返回 */				
	OSStart(&err);
}

/*
************************************************************************************************************************
*                                                    函数实现
************************************************************************************************************************
*/
/* 软件延时 */
void delay (uint32_t count)
{
	for(; count!=0; count--);
}



/* 任务1 */
void Task1( void *p_arg )
{
	for( ;; )
	{
		flag1 = 1;
		OSTimeDly(2);		//任务1执行完flag1=1后就被阻塞了， 任务2开始执行delay(10000)延时2ms后执行flag2=1,此时任务1还需要再阻塞18ms，任务2需要阻塞20ms。
		flag1 = 0;      //此时由于当前的两个任务都被阻塞了，故会去执行那一个空闲任务，空闲任务执行18ms后转去执行任务1，此时flag1为0（发生跳转）；flag1跳转后
		OSTimeDly(2);
 
	} 
}

/* 任务2 */
void Task2( void *p_arg )
{
	for( ;; )
	{
		delay(10000); //延时2ms
		flag2 = 1;
		OSTimeDly(2);		
		flag2 = 0; 
		OSTimeDly(2);
	}
}
/*
注意：是启动完操作系统的同时也是会启动Systick时钟中断的。
首先弄清楚任务1执行到哪里会被阻塞。
任务1执行完flag1=1后会被阻塞，此时执行的是OSTimeDly(2);函数，在这个函数中设置了任务1所延时的Systick时钟周期数为2，在这个函数中调用了任务切换OSSched()函数。
判断出执行这个OSSched()函数后

启动操作系统后就会启动Systick中断，在cpu执行任何一个任务的时候都是会进行计数，到达某个数后就会先暂停对某一个任务的执行，转而去执行这个中断服务函数。
任务1执行到OSTimeDly(2)，去执行这个函数，设置这个任务1的时钟周期数为2,然后执行OSSched（）任务切换函数切换到任务2去运行（根据当前任务为任务1决定执行最外面第2个if语句，任务列表
中任务2的时钟周期数为0，就切换到任务2去执行）。
任务2执行到 OSTimeDly(2)时会去执行这个函数（任务2执行到这个函数的时候中断从开始到现在的时间大致是为2ms的，还没有到达执行一次中断所需要的时间），设置这个任务2的时钟周期数为2，然
后执行		OSSched（）任务切换函数切换到空闲任务去运行（根据当前任务为任务2决定执行最外面的第3个if语句，又由于当前的任务列表中没有一个任务的时钟周期数为0，故会切换到空闲任务去执
行），切换到空闲任务后就会一直循环执行空闲任务所对应的那个函数。执行到一定时间后会触发一次时钟中断，此时会去执行时钟中断的中断服务函数，先队任务列表中所有任务的时钟周期数减1（
此时任务1和任务2的时钟周期数都是为1的），然后执行OSSched（）函数切换到空闲任务去执行。一直循环执行这个空闲任务，直到触发一次时钟中断，转去执行时钟中断的中断服务函数，先将任务列
表中所有任务的时钟周期数减1（此时任务1和任务2的时钟周期数都是为0的），然后执行OSSched()函数切换到任务1去执行。
任务1执行到OSTimeDly(2)时又会将任务1此时的时钟周期数置为2，执行OSSched（）切换到任务2去执行。

由于任务1两次	OSTimeDly(2)之间只执行了flag2=0，故当返回到任务1去执行时又会立刻执行OSTimeDly(2)调用OSSched()函数切换到任务2去执行（此时任务1的时钟周期数为2，而任务2的时钟周
期数为0，故会切换到任务2去执行）。



分析：为什么两者上升的时间不一样，而下降的时间确是一样的。
任务1执行flag1=1后会被阻塞20ms，此时执行任务2,延时2ms后flag2为1，然后flag2被阻塞20ms。
此时这两个任务都是处于阻塞的状态，故回去执行那个空闲任务，当任务1经过了1个时钟周期后会触发时钟中断的中断服务函数，使所有当前任务列表中剩余延时时钟周期大于0的都会减1，虽然任务2的
时钟中断的延时未达到一个周期也是会减1的。


Task1与Task2是同时醒过来的，因为执行了时钟中断的中断服务函数之后，它们所延时的时钟周期数会同时的减为0，此时唤醒的是优先级较高的那个任务（即是任务列表中被唤醒的任务中位于最前面的
那个任务）。
*/

