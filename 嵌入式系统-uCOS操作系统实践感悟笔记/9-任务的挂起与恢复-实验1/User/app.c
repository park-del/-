/*
************************************************************************************************************************
*                                                 包含的头文件
************************************************************************************************************************
*/
#include "os.h"
#include "ARMCM3.h"

/*
************************************************************************************************************************
*                                                   宏定义
************************************************************************************************************************
*/


/*
************************************************************************************************************************
*                                                  全局变量
************************************************************************************************************************
*/

uint32_t flag1;
uint32_t flag2;
uint32_t flag3;

/*
************************************************************************************************************************
*                                                  TCB & STACK & 任务声明
************************************************************************************************************************
*/
#define  TASK1_STK_SIZE       128
#define  TASK2_STK_SIZE       128
#define  TASK3_STK_SIZE       128


static   OS_TCB    Task1TCB;
static   OS_TCB    Task2TCB;
static   OS_TCB    Task3TCB;


static   CPU_STK   Task1Stk[TASK1_STK_SIZE];
static   CPU_STK   Task2Stk[TASK2_STK_SIZE];
static   CPU_STK   Task3Stk[TASK2_STK_SIZE];


void     Task1( void *p_arg );
void     Task2( void *p_arg );
void     Task3( void *p_arg );


/*
************************************************************************************************************************
*                                                  函数声明
************************************************************************************************************************
*/
void delay(uint32_t count);

/*
************************************************************************************************************************
*                                                    main函数
************************************************************************************************************************
*/
/*
* 注意事项：1、该工程使用软件仿真，debug需选择 Ude Simulator
*           2、在Target选项卡里面把晶振Xtal(Mhz)的值改为25，默认是12，
*              改成25是为了跟system_ARMCM3.c中定义的__SYSTEM_CLOCK相同，确保仿真的时候时钟一致
*/
int main(void)
{	
	OS_ERR err;	
	
	
	/* CPU初始化：1、初始化时间戳 */
	CPU_Init();	
	
	/* 关闭中断 */
	CPU_IntDis();
	
	/* 配置SysTick 10ms 中断一次 */
	OS_CPU_SysTickInit (10);
	
	/* 初始化相关的全局变量 */
	OSInit(&err);
	
	/* 创建任务 */
	OSTaskCreate( (OS_TCB       *)&Task1TCB, 
	              (OS_TASK_PTR   )Task1, 
                  (void         *)0,
				        (OS_PRIO       )1,  //优先级为1
				        (CPU_STK      *)&Task1Stk[0],
				        (CPU_STK_SIZE  )TASK1_STK_SIZE,
				        (OS_TICK       )0,  //时间片为0个时钟周期
				        (OS_ERR       *)&err );
				  
	OSTaskCreate( (OS_TCB       *)&Task2TCB, 
	              (OS_TASK_PTR   )Task2, 
                  (void         *)0,
				  (OS_PRIO       )3,      //优先级为3
				  (CPU_STK      *)&Task2Stk[0],
				  (CPU_STK_SIZE  )TASK2_STK_SIZE,
				  (OS_TICK       )1,      //时间片为1个时钟周期
				  (OS_ERR       *)&err );	
				  
	OSTaskCreate( (OS_TCB       *)&Task3TCB, 
	              (OS_TASK_PTR   )Task3, 
                  (void         *)0,
				  (OS_PRIO       )3,      //优先级为3
				  (CPU_STK      *)&Task3Stk[0],
				  (CPU_STK_SIZE  )TASK3_STK_SIZE,
				  (OS_TICK       )1,      //时间片为1个时钟周期
				  (OS_ERR       *)&err ); 
				  
	/* 启动OS，将不再返回 */				
	OSStart(&err);
}

/*
************************************************************************************************************************
*                                                    函数实现
************************************************************************************************************************
*/
/* 软件延时 */
void delay (uint32_t count)
{
	for(; count!=0; count--);
}
void Task1( void *p_arg )
{	OS_ERR err;
	  for( ;; ){
		flag1 = 1;
		OSTimeDly(2);	
    
		OSTaskSuspend(&Task3TCB,&err);	//将任务3挂起		
		
		flag1 = 0;
		OSTimeDly(2);	
    
		OSTaskResume(&Task3TCB,&err);	  //将任务3恢复
	}
}

void Task2( void *p_arg )
{
	for( ;; )
    {
		flag2 = 1;
		delay(0xff);		
		flag2 = 0;
		delay(0xff);
	}
}

void Task3( void *p_arg )
{
	for( ;; )
    {
		flag3 = 1;
		delay(0xff);		
		flag3 = 0;
		delay(0xff);
	}
}
/*
第1个时钟周期
执行OSTimeDly(2)之前：
就绪位表：0x5（0101） 000000 1（0001）                                         数组下标1：Task1                         数组下标3：Task2   Task3

执行OSTimeDly(2)之后：
就绪位表：0x1（0001） 000000 1（0001）                                         数组下标1：没有                          数组下标3：Task2   Task3

第2个时钟周期（触发1次时钟中断）
就绪位表：0x1（0001） 000000 1（0001）                                         数组下标1：没有                          数组下标3：Task3   Task2


第3个时钟周期（触发1次时钟中断）
执行OSTaskSuspend(&Task3TCB,&err)之后，执行OSTimeDly(2)之前：
就绪位表：0x5（0101） 000000 1（0001）                                         数组下标1：Task1                         数组下标3：Task2

执行OSTimeDly(2)之后：
就绪位表：0x1（0001） 000000 1（0001）                                         数组下标1：没有                          数组下标3：Task2   

第4个时钟周期（触发1次时钟中断）
就绪位表：0x1（0001） 000000 1（0001）                                         数组下标1：没有                          数组下标3：Task2                                           数组下标1：                         数组下标3：


第5个时钟周期（触发1次时钟中断）
执行OSTaskResume(&Task3TCB,&err)之后，执行OSTimeDly(2)之前：
就绪位表：0x5（0101） 000000 1（0001）                                         数组下标1：Task1                         数组下标3：Task3 Task2

执行OSTimeDly(2)之后：
就绪位表：0x1（0001） 000000 1（0001）                                         数组下标1：没有                          数组下标3：Task3   Task2

第6个时钟周期（触发1次时钟中断）
就绪位表：0x1（0001） 000000 1（0001）                                         数组下标1：没有                          数组下标3：Task2   Task3
*/







/*
第1个时钟周期：
执行0STimeDly(2)之前：
Task1执行执行0STimeDly(2)之前，flag1变为1，执行0STimeDly(2)后立即延时2个时钟周期。

执行OSTimeDly(2)之后：
Task1执行OSTimeDly(2)之后（在这个OSTimeDly(2)中，将Task1从就绪列表移动到了时基列表中，进行了任务切换），切换到了Task2去执行，Task2一直循环执行（时间片为1个时钟周期），


第2个时钟周期：
Task2循环执行第1个时钟周期后触发了时钟中断进入到第2个时钟周期（在时钟中断中执行任务切换，由Task2切换到Task3去执行），Task3一直循环执行（时间片为1个时钟周期）。

第3个时钟周期：
执行OSTimeDly(2)之前：
Task3循环执行第2个时钟周期后触发了时钟中断进入到第3个时钟周期（在时钟中断中唤醒了Task1，将Task1重新从时基列表移动到就绪列表中，进行了任务切换）。
进行任务切换到Task1，Task1将Task3挂起，令flag1为0，执行0STimeDly(2)后立即延时2个时钟周期。
 

执行OSTimeDly(2)之后：
Task1执行OSTimeDly(2)后（在这个OSTimeDly(2)中有进行任务切换），进行任务切换到Task2（因为此时Task3是已经被挂起的，故是不会切换到Task3的），Task2一直循环执行（时间片为1个时钟周期）。

第4个时钟周期：
此时，Task1是延时，Task3是挂起的，故触发时中断进行任务切换时所切换的还是为Task2的，Task2一直循环执行（时间片为1个时钟周期）。

第5个时钟周期：
执行OSTimeDly(2)之前：
Task2循环执行第4个时钟周期后触发了时钟中断进入到第5个时钟周期（在时钟中断中唤醒了Task1，进行了任务切换），切换到Task1执行，Task1先恢复Task3（Task3是插入到就绪列表中优先级3所对
应的链表的头部的，至于为什么见下面关于任务函数的分析），令flag1为1，执行OSTimeDly(2)延时两个时钟周期。

执行OSTimeDly(2)之后：
Task1执行OSTimeDly(2)之后（在这个OSTimeDly(2)函数中有进行任务切换），进行任务切换切换到了Task3去执行，Task3一直循环执行（时间片为1个时钟周期）。

第6个时钟周期：
Task3执行了第5个时钟中断后触发了时钟中断进入到第6个时钟周期（在时钟中断中进行了任务切换），切换到Task2执行，Task2一直循环执行（时间片为1个时钟周期）。


任务恢复函数：(课本P139 P115 与 P90)
在void OSTaskResume (OS_TCB *p_tcb,OS_ERR *p_err)任务恢复函数中，当判断出要恢复的p_tcb的p_tcb->SuspendCtr(任务挂起计数器)为0的话就会执行OS_TaskRdy(p_tcb)函数，
来完成优先级表插入与就绪位表插入的任务。

void OS_TaskRdy (OS_TCB *p_tcb)
{
  OS_TickListRemove(p_tcb);  //从时基列表删除
  OS_RdyListInsert(p_tcb);   //插入就绪列表
}

void OS_RdyListInsert (OS_TCB *p_tcb)
{
  OS_PrioInsert(p_tcb->Prio);    //将优先级插入到优先级表
  if (p_tcb->Prio == OSPrioCur) 
    OS_RdyListInsertTail(p_tcb); //如果是当前优先级则插入到链表尾部 
  else 
	  OS_RdyListInsertHead(p_tcb); //否则插入到链表头部 
}

分析：可以看出Task1恢复Task3时，由于要恢复的Task3的优先级与当前正在运行的Task1的优先级不一样，故Task3（优先级为3）是插入到就绪列表中优先级为3所对应的那个链表中的头部的。
*/