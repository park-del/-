/*
************************************************************************************************************************
*                                                 包含的头文件
************************************************************************************************************************
*/
#include "os.h"
#include "ARMCM3.h"
/*
************************************************************************************************************************
*                                                   宏定义
************************************************************************************************************************
*/


/*
************************************************************************************************************************
*                                                  全局变量
************************************************************************************************************************
*/

uint32_t flag1;
uint32_t flag2;

/*
************************************************************************************************************************
*                                                  TCB & STACK & 任务声明
************************************************************************************************************************
*/
#define  TASK1_STK_SIZE       20
#define  TASK2_STK_SIZE       20

static   CPU_STK   Task1Stk[TASK1_STK_SIZE];   //定义了一个线程Task1的工作堆栈Task1Stk
static   CPU_STK   Task2Stk[TASK2_STK_SIZE];   //定义了一个线程Task2的工作堆栈Task2Stk

static   OS_TCB    Task1TCB;     //线程Task1的TCB
static   OS_TCB    Task2TCB;     //线程Task2的TCB


//定义了两个功能函数
void     Task1( void *p_arg );
void     Task2( void *p_arg );

/*
************************************************************************************************************************
*                                                  函数声明
************************************************************************************************************************
*/
void delay(uint32_t count);

/*
************************************************************************************************************************
*                                                    main函数
************************************************************************************************************************
*/
/*
* 注意事项：1、该工程使用软件仿真，debug需选择 Ude Simulator
*           2、在Target选项卡里面把晶振Xtal(Mhz)的值改为25，默认是12，
*              改成25是为了跟system_ARMCM3.c中定义的__SYSTEM_CLOCK相同，确保仿真的时候时钟一致
*/
int main(void)
{	
	OS_ERR err;     //利用OS_ERR所定义的一个对象是为一个操作系统的
	
	
	
	/* 初始化相关的全局变量 */
	OSInit(&err);  //对所定义的这个操作系统进行初始化，所谓的对操作系统的初始化其实就是定义一些操作系统运行时所需要的数据结构的，如定义一些就绪列表等
	
	/* 创建任务 */
	OSTaskCreate ((OS_TCB*)      &Task1TCB, 
	              (OS_TASK_PTR ) Task1, 
	              (void *)       0,
	              (CPU_STK*)     &Task1Stk[0],
	              (CPU_STK_SIZE) TASK1_STK_SIZE,
	              (OS_ERR *)     &err);
/*
程序中相关语句的说明：				
1、可以自定义多个线程，利用多线程编程，每一个线程都是一个独立的main函数，各个线程之间是并发执行的。

2、每一个线程是包含3部分的，每一个线程都包含有这个线程唯一的标识TCB，这个线程工作时的堆栈，这个线程需要执行的任务（即是这个线程需要执行的函数）。
   利用 OS_TCB 可以定义一个线程的TCB（创建了一个线程的TCB就是创建了一个线程，当创建了多个TCB时也就是创建了多个线程的）；
	 利用 CPU_STK	 可以定义一个线程工作时的堆栈的，每一个线程都对应有一个工作堆栈的，这个堆栈的作用就是当切换到另一个线程时保存当前的这个线程的现场的，使得当再次切换到当前这个
			线程时可以回到这个线程原来的断点处，使得这个线程可以继续接着原来的工作执行。
	 	 
	 利用OSTaskCreate()函数可以使的所创建的某一个线程去执行某一个任务，即是使所创建的某一个线程去执行某一个函数，这个函数中是由6个参数的。
			(OS_TCB*)    &Task1TCB      ：为某一个线程的TCB，指明这是哪一个线程的。
		  (OS_TASK_PTR ) Task1        ：Task1是为一个函数的函数名的，这个函数也就是所关联的这个线程Task1TCB需要执行的函数。
			(void *)       0				    ：每一个线程当执行某一个函数时是可以给这个函数传递一个参数的，OSTaskCreate()函数中的这个参数就是传递给该线程所执行的那个函数Task1()的参数。
		  (CPU_STK*)     &Task1Stk[0]	：Task1Stk是为用OS_TCB所定义的一个线程的工作堆栈的，当这个线程在执行其所对应的函数时，是有可能暂时终止该线程的执行，从而去切换到另一个线程
								                    的，故需要有一个工作堆栈来保存这个线程的现场，这里所传递的参数Task1Stk[0]就是为一个线程的工作堆栈的，由于刚开始时堆栈是为空的，此时元素进
								                    入到栈中的第0号位置，故所传递的参数是为Task1Stk[0]。
		  (CPU_STK_SIZE) TASK1_STK_SIZE	 ：这个参数是为这个线程所对应的工作堆栈的大小的。
			(OS_ERR *)     &err		      ：线程是运行在一个操作系统上的，这里的参数err就是这个线程所运行的操作系统。
								
								
				
注意：在调用OSTaskCreate()函数后只是指明了一个线程运行时所执行的函数的，此时这个线程是还没有执行这个函数的，这里只是对这多个线程所需要执行的函数进行一些说明。
      当启动完操作操作系统会从就绪队列中取出一个线程，此时这个线程   						
*/							
	OSTaskCreate ((OS_TCB*)      &Task2TCB, 
	              (OS_TASK_PTR ) Task2, 
	              (void *)       0,
	              (CPU_STK*)     &Task2Stk[0],
	              (CPU_STK_SIZE) TASK2_STK_SIZE,
	              (OS_ERR *)     &err);
				  
	 
	OSRdyList[0].HeadPtr = &Task1TCB;     //将线程Task1TCB插入到就绪队列OSRdyList中
	OSRdyList[1].HeadPtr = &Task2TCB;     //将线程Task2TCB插入到就绪队列OSRdyList中
	
	/* 启动OS，将不再返回 */				
	OSStart(&err);
	/*
	当启动完操作系统后，操作系统会从就绪队列中取出一个线程，此时这个线程就会执行其所对应的那个函数，操作系统取出的那个线程是为就绪队列中最前面的那个线程的，
  各个线程是按照其在就绪队列中的顺序依次去执行其所对应的那一个函数的（就绪队列中的线程是按照先进先出的原则的），在某一时刻是只能有一个线程去执行其所对应的函数的，
  当一个线程被阻塞后等到要运行时在插入到就绪队列中，此时是插在这个就绪队列的末尾的。虽然各个线程在微观上是串行执行的，但是在宏观上确是并发执行的。													
  */
													
}

/*
************************************************************************************************************************
*                                                    函数实现
************************************************************************************************************************
*/
/* 软件延时 */
void delay (uint32_t count)
{
	for(; count!=0; count--);
}



/* 任务1 */
void Task1( void *p_arg )
{
	for( ;; )
	{
		flag1 = 1;
		delay( 100 );		
		flag1 = 0;
		delay( 100 );		
		 	
		OSSched();//OSSched()函数会查找已经就绪的最高优先级的任务，并继续运行该任务，即是OSSched()函数是可以没有参数的，调用OSSched()切换的是就绪队列中最高优先级的那个线程，即是
	//处于就绪队列中最前面的那个线程，这是由操作系统自动决定的。
	}
}
/* 任务2 */
void Task2( void *p_arg )
{
	for( ;; )
	{
		flag2 = 1;
		delay( 100 );		
    OSSched(); 
		flag2 = 0;
		delay( 100 );		
	 
		
	}
}


